## config/west.yml
```yaml
manifest:
  remotes:
    - name: zmkfirmware
      url-base: https://github.com/zmkfirmware
    - name: urob
      url-base: https://github.com/urob
    - name: crystalplanet
      url-base: https://github.com/crystalplanet
  projects:
    - name: eyelash_sofle
      url: https://github.com/a741725193/zmk-sofle
      revision: main
    - name: zmk
      remote: zmkfirmware
      revision: v0.3.0
      import: app/west.yml
    - name: zmk-nodefree-config
      remote: urob
      revision: main
    - name: zmk-rgb-fx
      remote: crystalplanet
      revision: main
  self:
    path: boards
```
